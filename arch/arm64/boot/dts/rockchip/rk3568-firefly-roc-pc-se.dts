// SPDX-License-Identifier: (GPL-2.0+ OR MIT)
/*
 * Copyright (c) 2020 Rockchip Electronics Co., Ltd.
 *
 */

/dts-v1/;

#include "rk3568-firefly-roc-pc-se.dtsi"

/*
*
* using single camera xc7160        --->  rk3568-firefly-roc-pc-se-cam-8ms1m.dtsi
* using dual camera gc2053/gc2093   --->  rk3568-firefly-roc-pc-se-cam-2ms2m.dtsi
* using rk628d                      --->  rk3568-firefly-roc-pc-se-tf-hdmi-mipi-rk628.dtsi
*
*/
#include "rk3568-firefly-roc-pc-se-cam-8ms1m.dtsi"

/ {
    model = "Firefly RK3568-ROC-PC-SE HDMI (Linux)";
    compatible = "rockchip,rk3568-firefly-roc-pc-se", "rockchip,rk3568";

};

&route_hdmi {
    status = "okay";
    connect = <&vp0_out_hdmi>;
};
