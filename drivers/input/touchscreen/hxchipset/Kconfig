## drivers/input/touchscreen/hxchipset/Kconfig
```kconfig
##
## Himax Touchscreen driver configuration
##
config TOUCHSCREEN_HIMAX_CHIPSET
		tristate "HIMAX chipset i2c touchscreen"
		depends on I2C
		select TOUCHSCREEN_HIMAX_COMMON
		help 
		  This enables support for HIMAX CHIPSET over 
		  I2C based touchscreens. 

		  You must select on-cell or in-cell IC type

config TOUCHSCREEN_HIMAX_COMMON
		tristate "HIMAX I2C touchscreen driver framework"
		select TOUCHSCREEN_HIMAX_INCELL
		help 
		  This enables support for HIMAX CHIPSET over I2C based touchscreens.

choice
	prompt "Select HIMAX IC type"
	default TOUCHSCREEN_HIMAX_INCELL
	depends on TOUCHSCREEN_HIMAX_CHIPSET

config TOUCHSCREEN_HIMAX_INCELL
		bool "HIMAX chipset in-cell"
		help 
		  This enables support for HIMAX CHIPSET of in-cell function.
endchoice

config TOUCHSCREEN_HIMAX_DEBUG
		bool "HIMAX debug output"
		depends on TOUCHSCREEN_HIMAX_INCELL
		help 
		  This enables driver debug output.

## ***************** In-cell Start *****************
config TOUCHSCREEN_HIMAX_IC_HX83102
		tristate "HIMAX chipset HX83102 function"
		depends on TOUCHSCREEN_HIMAX_INCELL
		help
		  This enables support for HIMAX CHIPSET of HX83102.
## ***************** In-cell End *******************
```
